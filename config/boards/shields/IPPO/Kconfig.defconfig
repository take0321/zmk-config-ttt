## config/boards/shields/IPPO/Kconfig.defconfig
```kconfig
# Copyright (c) 2020 The ZMK Contributors
# SPDX-License-Identifier: MIT

if SHIELD_IPPO_LEFT

config ZMK_KEYBOARD_NAME
	default "IPPO glp"

config ZMK_SPLIT_ROLE_CENTRAL
	default y

endif

if SHIELD_IPPO_LEFT || SHIELD_IPPO_RIGHT

config ZMK_SPLIT
	default y

endif
```

## config/boards/shields/IPPO/Kconfig.shield
```kconfig
# Copyright (c) 2020 The ZMK Contributors
# SPDX-License-Identifier: MIT

config SHIELD_IPPO_LEFT
    def_bool $(shields_list_contains,IPPO_left)

config SHIELD_IPPO_RIGHT
    def_bool $(shields_list_contains,IPPO_right)
```
